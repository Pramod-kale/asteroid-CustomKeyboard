/dts-v1/;

/ {
    model = "Asteroid";
    compatible = "zmk,keyboard";

    chosen {
        zmk,kscan = &kscan0;
        zmk,matrix_transform = &default_transform;
    };

    kscan0: kscan_0 {
        compatible = "zmk,kscan-gpio-matrix";
        label = "KSCAN";
        diode-direction = "row2col";  // Diodes oriented from row to column
        rows = <5>;
        cols = <6>;
        row-gpios
            = <&gpio0 0 GPIO_ACTIVE_HIGH>  // Placeholder, will override in left/right
            , <&gpio0 0 GPIO_ACTIVE_HIGH>
            , <&gpio0 0 GPIO_ACTIVE_HIGH>
            , <&gpio0 0 GPIO_ACTIVE_HIGH>
            , <&gpio0 0 GPIO_ACTIVE_HIGH>;
        col-gpios
            = <&gpio0 0 GPIO_ACTIVE_HIGH>  // Placeholder, will override in left/right
            , <&gpio0 0 GPIO_ACTIVE_HIGH>
            , <&gpio0 0 GPIO_ACTIVE_HIGH>
            , <&gpio0 0 GPIO_ACTIVE_HIGH>
            , <&gpio0 0 GPIO_ACTIVE_HIGH>
            , <&gpio0 0 GPIO_ACTIVE_HIGH>;
    };
};